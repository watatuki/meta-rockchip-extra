## conf/layer.conf
```bitbake
# We have a conf and classes directory, add to BBPATH
BBPATH .= ":${LAYERDIR}"

# We have recipes-* directories, add to BBFILES
BBFILES += "${LAYERDIR}/recipes-*/*/*.bb \
	    ${LAYERDIR}/recipes-*/*/*.bbappend"

BBFILE_COLLECTIONS += "rockchip-extra"
BBFILE_PATTERN_rockchip-extra := "^${LAYERDIR}/"
BBFILE_PRIORITY_rockchip-extra = "19"

BBFILES_DYNAMIC += " \
    qt5-layer:${LAYERDIR}/dynamic-layers/meta-qt5/*/*/*.bb \
    qt5-layer:${LAYERDIR}/dynamic-layers/meta-qt5/*/*/*.bbappend \
"

LAYERDEPENDS_rockchip-extra = "rockchip"

LAYERVERSION_rockchip-extra = "1"
LAYERSERIES_COMPAT_rockchip-extra = "kirkstone"
```

## conf/machine/rockchip-rk3399-nanopc-t4.conf
```bitbake
#@TYPE: Machine
#@NAME: RK3399 Sapphire Excavator

require conf/machine/include/rk3399.inc

KERNEL_DEVICETREE = "rockchip/rk3399-nanopi4-rev00.dtb"

UBOOT_MACHINE = "rk3399_defconfig"

RK_WIFIBT_FIRMWARES = " \
"

MACHINE_EXTRA_RRECOMMENDS_append += " \
	linux-firmware-rk-cdndp \
"
```
